## CMakeLists.txt
```
# SPDX-License-Identifier: Apache-2.0

cmake_minimum_required(VERSION 3.28.0)

list(APPEND EXTRA_ZEPHYR_MODULES
  ${CMAKE_CURRENT_SOURCE_DIR}/../../modules/libloris
)

find_package(Zephyr REQUIRED HINTS $ENV{ZEPHYR_BASE})
project(blinky)


target_sources(app PRIVATE src/main.c)
```

## prj.conf
```kconfig
CONFIG_GPIO=y
CONFIG_ADC=y
```

## boards/doit_esp32_devkit_v1.overlay
```dts
/ {
	// We set alias here so later in code we can completely abstract device
	// tree and reference the sensor by just the alias
	// aliases = {
	// 	temp-sensor = &temp_sensor
	// }

    zephyr,user {
        io-channels = <&adc0 7>;
    };
};


&adc0 {
    status = "okay";
    #address-cells = <1>;
    #size-cells = <0>;

    channel7: channel@7 {
        reg = <7>;
        zephyr,gain = "ADC_GAIN_1_4"; 
        zephyr,reference = "ADC_REF_INTERNAL";
        zephyr,acquisition-time = <ADC_ACQ_TIME_DEFAULT>;
        zephyr,resolution = <12>;
    };
};
```

## src/main.c
```c
/*
 * Copyright (c) 2016 Intel Corporation
 *
 * SPDX-License-Identifier: Apache-2.0
 */

#include "zephyr/sys/slist.h"
#include <zephyr/devicetree.h>
#include <zephyr/drivers/adc.h>
#include <zephyr/kernel.h>

static const struct adc_dt_spec adc_channel =
    ADC_DT_SPEC_GET(DT_PATH(zephyr_user));

int16_t sample_buffer[1];

struct adc_sequence sequence = {
  .buffer = sample_buffer,
  .buffer_size = sizeof(sample_buffer),
  // Optional: resolution, etc. Usually taken from DT
};

int main(void) {

  int err;

  if (!adc_is_ready_dt(&adc_channel)) {
    printk("ADC is not ready\n");
    return 0;
  }

  /* 1. Configure the channel (Gain, Reference, Acquisition time) */
  /* Zephyr configures this automatically if we use ADC_DT_SPEC_GET
     and define it correctly in the overlay, or we can do it manually: */
  err = adc_channel_setup_dt(&adc_channel);
  if (err < 0) {
    printk("Error configuring channel (%d)\n", err);
    return 0;
  }

  /* 2. Prepare the sequence */
  /* We tell it which specific channel to read using the Devicetree info */
  err = adc_sequence_init_dt(&adc_channel, &sequence);
  if (err < 0) {
    printk("Error initializing sequence\n");
    return 0;
  }

  while (1) {
    /* 3. Read (Blocking) */
    err = adc_read(adc_channel.dev, &sequence);
    if (err < 0) {
      printk("Error reading ADC (%d)\n", err);
    } else {
      /* 4. Convert to millivolts (Optional but useful) */
      int32_t val_mv = sample_buffer[0];

      /* This function uses the reference and gain configuration
         to give us real millivolts */
      if (adc_raw_to_millivolts_dt(&adc_channel, &val_mv) == 0) {
        printk("Raw reading: %d, voltage: %d mV\n", sample_buffer[0], val_mv);
      } else {
        printk(
            "Raw reading: %d; reference not convertible to mV\n",
            sample_buffer[0]
        );
      }
    }

    k_msleep(1000);
  }
  return 0;
}
```
