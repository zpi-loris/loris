## CMakeLists.txt
```
cmake_minimum_required(VERSION 3.20.0)

list(APPEND EXTRA_ZEPHYR_MODULES ${CMAKE_CURRENT_SOURCE_DIR}/..)

find_package(Zephyr REQUIRED HINTS $ENV{ZEPHYR_BASE})
project(test_libloris)

FILE(GLOB test_srcs src/*.c)

target_sources(app PRIVATE ${test_srcs})
```

## prj.conf
```kconfig
CONFIG_ZTEST=y

CONFIG_HEAP_MEM_POOL_SIZE=4096 

CONFIG_LOG=y
CONFIG_LOG_MAX_LEVEL=2
CONFIG_LOG_DEFAULT_LEVEL=4

CONFIG_LORA=y
CONFIG_LORA_FAKE=y
# CONFIG_LORAWAN=y
# CONFIG_LORAWAN_SYSTEM_MAX_RX_ERROR=100
# CONFIG_LORAWAN_REGION_EU868=y

CONFIG_ZMS=y

CONFIG_FLASH=y
CONFIG_FLASH_MAP=y

CONFIG_LORIS=y
CONFIG_LORIS_TEST=y
CONFIG_MIN_HEAP=y
```

## app.overlay
```dts
/ {
  aliases {
    lora0 = &fakelora;
  };

  fakelora: fakelora {
    compatible = "zephyr,fake-lora";
    status = "okay";
  };
};
```

## src/setup.c
```c
/* GLOBAL TESTS SETUP
 *
 * Needed because FFF DEFINE_FFF_GLOBALS macro needs to be always called,
 * because we're using a global LoRa fake driver
 */

#include <zephyr/fff.h>

DEFINE_FFF_GLOBALS;
```

## src/test_capabilities.c
```c
#include <assert.h>
#include <zephyr/ztest.h>

#include "loris/models/capabilities.h"
#include "loris/models/function.h"
#include "loris/models/report.h"
#include "loris/models/sensor.h"
#include "loris/str.h"
#include "zephyr/sys/slist.h"
#include "zephyr/ztest_assert.h"
#include "zephyr/ztest_test.h"

ZTEST_SUITE(capabilities, NULL, NULL, NULL, NULL, NULL);

capabilities_t cap;

report_t report_func(struct sensor* t) {
  report_t rep = { .sensor_id = t->id,
                   .value = { 2 },
                   .which_value = REPORT_VALUE_INT };
  return rep;
};

sensor_t* get_sensor_at_idx(sys_slist_t* sensor_list, int idx) {
  sensor_t* sensor;

  int i = 0;
  SYS_SLIST_FOR_EACH_CONTAINER(sensor_list, sensor, node) {
    if (i == idx) {
      return sensor;
    }
    i++;
  }
  return NULL;
}

function_t* get_func_at_idx(sys_slist_t* func_list, int idx) {
  function_t* func;

  int i = 0;
  SYS_SLIST_FOR_EACH_CONTAINER(func_list, func, node) {
    if (i == idx) {
      return func;
    }
    i++;
  }
  return NULL;
}

ZTEST(capabilities, test_add_sensors_to_the_list) {
  capabilities_init(&cap, "capabilities_sensors", DEVICE_CLASS_A);

  zassert_equal(
      capabilities_add_sensor(
          &cap,
          "test_name 1",
          "Measures temperature",
          SENSOR_VALUE_TYPE_FLOAT,
          SENSOR_SEMANTICS_TEMPERATURE,
          "C",
          &report_func,
          60
      ),
      OK
  );
  zassert_equal(
      capabilities_add_sensor(
          &cap,
          "test_name 2",
          "Measures temperature",
          SENSOR_VALUE_TYPE_FLOAT,
          SENSOR_SEMANTICS_TEMPERATURE,
          "F",
          &report_func,
          30
      ),
      OK
  );

  sensor_t* fst_sensor = get_sensor_at_idx(&cap.sensors, 0);
  sensor_t* snd_sensor = get_sensor_at_idx(&cap.sensors, 1);

  str_t str1;
  str_t str2;
  str_from_static(&str1, "test_name 1");
  str_from_static(&str2, "test_name 2");

  if (fst_sensor != NULL) {
    zassert_str_equal(fst_sensor->name.ptr, str1.ptr);
  }
  if (snd_sensor != NULL) {
    zassert_str_equal(snd_sensor->name.ptr, str2.ptr);
  }
  zassert_not_equal(sys_slist_len(&cap.sensors), 0);
  zassert_equal(sys_slist_len(&cap.sensors), 2);
  if (fst_sensor != NULL && snd_sensor != NULL) {
    zassert_equal(fst_sensor->node.next, &snd_sensor->node);
  }
}

ZTEST(capabilities, test_check_read_function_from_capabilities) {
  sensor_t* fst_sensor = get_sensor_at_idx(&cap.sensors, 0);
  sensor_t* snd_sensor = get_sensor_at_idx(&cap.sensors, 1);

  report_t fst_report = fst_sensor->read_func(fst_sensor);
  report_t snd_report = snd_sensor->read_func(snd_sensor);

  zassert_equal(fst_report.value.int_val, snd_report.value.int_val);
  zassert_equal(fst_report.value.int_val, 2);
}

/*
ZTEST(capabilities, test_add_functions_to_the_list) {
  zassert_equal(
      capabilities_add_function(
          &cap,
          "do_sth_1",
          "does sth 1",
          FUNC_ARG_TYPE_INT,
          &do_sth_int,
          0
      ),
      OK
  );
  zassert_equal(
      capabilities_add_function(
          &cap,
          "do_sth_2",
          "does sth 2",
          FUNC_ARG_TYPE_FLOAT,
          &do_sth_float,
          3
      ),
      OK
  );

  function_t* int_func = get_func_at_idx(&cap.functions, 0);
  function_t* float_func = get_func_at_idx(&cap.functions, 1);

  if (int_func != NULL) {
    int a = 1;
    void* ptr = &a;
    zassert_equal(int_func->call_function(ptr), OK);
  }
  if (float_func != NULL) {
    float b = 2;
    void* ptr = &b;
    zassert_equal(float_func->call_function(ptr), OK);
  }
  zassert_not_equal(sys_slist_len(&cap.functions), 0);
  zassert_equal(sys_slist_len(&cap.functions), 2);
}

*/
```

## src/test_codec.c
```c
#include <zephyr/ztest.h>

#include "loris/codec.h"

ZTEST_SUITE(codec_downlink, NULL, NULL, NULL, NULL, NULL);

void assert_downlinks_equal(const downlink_t* d1, const downlink_t* d2) {
  zassert_equal(d1->payload_type, d2->payload_type);
  switch (d1->payload_type) {
  case DOWNLINK_PAYLOAD_TYPE_CALL:
    zassert_equal(d1->payload.call.function_id, d2->payload.call.function_id);
    zassert_equal(
        d1->payload.call.has_wake_after_secs,
        d2->payload.call.has_wake_after_secs
    );

    if (d1->payload.call.has_wake_after_secs) {
      zassert_equal(
          d1->payload.call.wake_after_secs,
          d2->payload.call.wake_after_secs
      );
    }

    zassert_equal(d1->payload.call.which_value, d2->payload.call.which_value);

    switch (d1->payload.call.which_value) {
    case CALL_VALUE_INT:
      zassert_equal(
          d1->payload.call.value.int_val,
          d2->payload.call.value.int_val
      );
      break;
    case CALL_VALUE_FLOAT:
      zassert_equal(
          d1->payload.call.value.float_val,
          d2->payload.call.value.float_val
      );
      break;
    case CALL_VALUE_STRING:
      zassert_str_equal(
          d1->payload.call.value.str_val.ptr,
          d2->payload.call.value.str_val.ptr
      );
      break;
    case CALL_VALUE_BOOL:
      zassert_equal(
          d1->payload.call.value.bool_val,
          d2->payload.call.value.bool_val
      );
      break;
    }
    break;
  case DOWNLINK_PAYLOAD_TYPE_PING:
    zassert_equal(d1->payload.ping.type, d2->payload.ping.type);
    break;
  }
}

void mk_call_downlink(downlink_t* out, call_value_type_t type, void* value) {
  out->payload_type = DOWNLINK_PAYLOAD_TYPE_CALL;
  out->payload.call.function_id = 2;
  out->payload.call.which_value = type;
  switch (type) {
  case CALL_VALUE_INT:
    out->payload.call.value.int_val = *(int*)value;
    break;
  case CALL_VALUE_FLOAT:
    out->payload.call.value.float_val = *(float*)value;
    break;
  case CALL_VALUE_STRING:
    out->payload.call.value.str_val = *(str_t*)value;
    break;
  case CALL_VALUE_BOOL:
    out->payload.call.value.bool_val = *(bool*)value;
    break;
  }
}

typedef struct call_downlink_conf {
  call_value_type_t type;
  union {
    int int_val;
    float float_val;
    str_t str_val;
    bool bool_val;
  } value;
} call_downlink_conf_t;

static const call_downlink_conf_t call_confs[] = {
    {.type = CALL_VALUE_STRING,
     .value.str_val =
         {
             .ptr = "hehe",
             .len = 4,
             .src_type = STR_SRC_STATIC,
         }},
    {
        .type = CALL_VALUE_INT,
        .value.int_val = 4,
    },
    {
        .type = CALL_VALUE_FLOAT,
        .value.float_val = 3.14f,
    },
    {
        .type = CALL_VALUE_BOOL,
        .value.bool_val = true,
    }
};

ZTEST_DEFINE_PARAM_VALUES_ARRAY(call_downlink_confs, call_confs);
ZTEST_INSTANTIATE_TEST_SUITE_P(
    calls,
    codec_downlink,
    test_encodes_and_decodes_call,
    call_downlink_confs
);
ZTEST_P(codec_downlink, test_encodes_and_decodes_call) {
  downlink_t dl = { 0 };
  call_downlink_conf_t conf = ZTEST_GET_PARAM(call_downlink_conf_t);
  mk_call_downlink(&dl, conf.type, &conf.value);

  char buf[1024];
  size_t bytes_written = 0;
  zassert_equal(encode_downlink(buf, sizeof(buf), &dl, &bytes_written), OK);
  zassert_not_equal(bytes_written, 0);

  downlink_t decoded = { 0 };
  zassert_equal(decode_downlink(&decoded, buf, bytes_written), OK);
  assert_downlinks_equal(&dl, &decoded);
}

static const down_ping_type_t downping_types[] = {
  DOWN_PING_TYPE_UNSPECIFIED,
  DOWN_PING_TYPE_DISCONNECT,
  DOWN_PING_TYPE_HELLO,
};

ZTEST_DEFINE_PARAM_VALUES_ARRAY(down_ping_types, downping_types);
ZTEST_INSTANTIATE_TEST_SUITE_P(
    downpingtypes,
    codec_downlink,
    test_encodes_and_decodes_downping,
    down_ping_types
);
ZTEST_P(codec_downlink, test_encodes_and_decodes_downping) {
  down_ping_type_t type = ZTEST_GET_PARAM(down_ping_type_t);
  downlink_t dl = { .payload_type = DOWNLINK_PAYLOAD_TYPE_PING,
                    .payload.ping = {
                        .type = type,
                    } };

  char buf[1024];
  size_t bytes_written = 0;
  zassert_equal(encode_downlink(buf, sizeof(buf), &dl, &bytes_written), OK);
  zassert_true(bytes_written > 0);

  downlink_t decoded = { 0 };
  zassert_equal(decode_downlink(&decoded, buf, bytes_written), OK);
  assert_downlinks_equal(&dl, &decoded);
}

ZTEST_SUITE(codec_uplink, NULL, NULL, NULL, NULL, NULL);

void assert_sensors_equal(const sensor_t* s1, const sensor_t* s2) {
  zassert_equal(s1->id, s2->id, "%i != %i", s1->id, s2->id);
  zassert_str_equal(s1->name.ptr, s2->name.ptr);
  zassert_str_equal(s1->description.ptr, s2->description.ptr);
  zassert_equal(s1->value_type, s2->value_type);
  zassert_equal(s1->semantics, s2->semantics);
  zassert_equal(s1->has_unit, s2->has_unit);
  if (s1->has_unit) {
    zassert_str_equal(s1->unit.ptr, s2->unit.ptr);
  }

  // Not transmitted
  // zassert_equal(s1->wake_interval_sec, s2->wake_interval_sec);
}

void assert_functions_equal(const function_t* f1, const function_t* f2) {
  zassert_equal(f1->id, f2->id);
  zassert_str_equal(f1->name.ptr, f2->name.ptr);
  zassert_str_equal(f1->description.ptr, f2->description.ptr);
  zassert_equal(f1->arg_type, f2->arg_type);

  // Not transmitted
  // zassert_equal(f1->wake_interval_sec, f2->wake_interval_sec);
}

void assert_capabilities_equal(
    const capabilities_t* c1,
    const capabilities_t* c2
) {
  zassert_str_equal(c1->device_name.ptr, c2->device_name.ptr);

  // device class is not transmitted
  // zassert_equal(c1->device_class, c2->device_class);

  // sensors
  zassert_equal(sys_slist_len(&c1->sensors), sys_slist_len(&c2->sensors));

  sys_snode_t* node1 = sys_slist_peek_head(&c1->sensors);
  sys_snode_t* node2 = sys_slist_peek_head(&c2->sensors);

  while (node1 != NULL && node2 != NULL) {
    sensor_t* s1 = CONTAINER_OF(node1, sensor_t, node);
    sensor_t* s2 = CONTAINER_OF(node2, sensor_t, node);

    assert_sensors_equal(s1, s2);

    node1 = sys_slist_peek_next(node1);
    node2 = sys_slist_peek_next(node2);
  }

  // functions
  zassert_equal(sys_slist_len(&c1->functions), sys_slist_len(&c2->functions));

  node1 = sys_slist_peek_head(&c1->functions);
  node2 = sys_slist_peek_head(&c2->functions);

  while (node1 != NULL && node2 != NULL) {
    function_t* f1 = CONTAINER_OF(node1, function_t, node);
    function_t* f2 = CONTAINER_OF(node2, function_t, node);

    assert_functions_equal(f1, f2);

    node1 = sys_slist_peek_next(node1);
    node2 = sys_slist_peek_next(node2);
  }
}

void assert_uplinks_equal(const uplink_t* u1, const uplink_t* u2) {
  zassert_equal(u1->payload_type, u2->payload_type);
  switch (u1->payload_type) {
  case UPLINK_PAYLOAD_TYPE_REPORT:
    zassert_equal(u1->payload.report.sensor_id, u2->payload.report.sensor_id);
    zassert_equal(
        u1->payload.report.which_value,
        u2->payload.report.which_value
    );
    switch (u1->payload.report.which_value) {
    case REPORT_VALUE_INT:
      zassert_equal(
          u1->payload.report.value.int_val,
          u2->payload.report.value.int_val
      );
      break;
    case REPORT_VALUE_FLOAT:
      zassert_equal(
          u1->payload.report.value.float_val,
          u2->payload.report.value.float_val
      );
      break;
    case REPORT_VALUE_STRING:
      zassert_str_equal(
          u1->payload.report.value.str_val.ptr,
          u2->payload.report.value.str_val.ptr
      );
      break;
    case REPORT_VALUE_BOOL:
      zassert_equal(
          u1->payload.report.value.bool_val,
          u2->payload.report.value.bool_val
      );
      break;
    }
    break;
  case UPLINK_PAYLOAD_TYPE_CAPABILITIES:
    assert_capabilities_equal(
        &u1->payload.capabilities,
        &u2->payload.capabilities
    );
    break;
  case UPLINK_PAYLOAD_TYPE_PING:
    zassert_equal(u1->payload.ping.type, u2->payload.ping.type);
    break;
  }
}

void mk_report_uplink(uplink_t* out, report_value_type_t type, void* value) {
  out->payload_type = UPLINK_PAYLOAD_TYPE_REPORT;
  out->payload.report.sensor_id = 2;
  out->payload.report.which_value = type;
  switch (type) {
  case REPORT_VALUE_INT:
    out->payload.report.value.int_val = *(int*)value;
    break;
  case REPORT_VALUE_FLOAT:
    out->payload.report.value.float_val = *(float*)value;
    break;
  case REPORT_VALUE_STRING:
    out->payload.report.value.str_val = *(str_t*)value;
    break;
  case REPORT_VALUE_BOOL:
    out->payload.report.value.bool_val = *(bool*)value;
    break;
  }
}

static const up_ping_type_t upts[] = {
  UP_PING_TYPE_UNSPECIFIED,
  UP_PING_TYPE_HELLO,
};

ZTEST_DEFINE_PARAM_VALUES_ARRAY(upping_types, upts);
ZTEST_INSTANTIATE_TEST_SUITE_P(
    upping_types,
    codec_uplink,
    test_encodes_and_decodes_upping,
    upping_types
);
ZTEST_P(codec_uplink, test_encodes_and_decodes_upping) {
  up_ping_type_t type = ZTEST_GET_PARAM(up_ping_type_t);
  uplink_t ul = { .payload_type = UPLINK_PAYLOAD_TYPE_PING,
                  .payload.ping.type = type };

  char buf[1024];
  size_t bytes_written = 0;
  zassert_equal(encode_uplink(buf, sizeof(buf), &ul, &bytes_written), OK);
  zassert_not_equal(bytes_written, 0);

  uplink_t decoded = { 0 };
  zassert_equal(decode_uplink(&decoded, buf, bytes_written), OK);
  zassert_equal(decoded.payload_type, UPLINK_PAYLOAD_TYPE_PING);
  zassert_equal(decoded.payload.ping.type, type);
  uplink_free(&decoded);
}

typedef struct report_uplink_conf {
  report_value_type_t type;
  union {
    int int_val;
    float float_val;
    str_t str_val;
    bool bool_val;
  } value;
} report_conf_t;

static const report_conf_t report_confs[] = {
    {.type = REPORT_VALUE_STRING,
     .value.str_val =
         {
             .ptr = "hehe",
             .len = 4,
             .src_type = STR_SRC_STATIC,
         }},
    {
        .type = REPORT_VALUE_INT,
        .value.int_val = 4,
    },
    {
        .type = REPORT_VALUE_FLOAT,
        .value.float_val = 3.14f,
    },
    {
        .type = REPORT_VALUE_BOOL,
        .value.bool_val = true,
    }
};

ZTEST_DEFINE_PARAM_VALUES_ARRAY(rep_confs, report_confs);
ZTEST_INSTANTIATE_TEST_SUITE_P(
    rep_configs,
    codec_uplink,
    test_encodes_and_decodes_report,
    rep_confs
);
ZTEST_P(codec_uplink, test_encodes_and_decodes_report) {
  report_conf_t conf = ZTEST_GET_PARAM(report_conf_t);
  uplink_t ul = { 0 };
  mk_report_uplink(&ul, conf.type, &conf.value);

  char buf[1024];
  size_t bytes_written = 0;
  zassert_equal(encode_uplink(buf, sizeof(buf), &ul, &bytes_written), OK);
  zassert_true(bytes_written > 0);

  uplink_t decoded = { 0 };
  zassert_equal(decode_uplink(&decoded, buf, bytes_written), OK);
  zassert_equal(ul.payload_type, decoded.payload_type);
  uplink_free(&decoded);
}

ZTEST(codec_uplink, test_encodes_and_decodes_capabilities) {
  sensor_t s1 = {
    .id = 1,
    .name = { .ptr = "Temperature", .len = 11, .src_type = STR_SRC_STATIC },
    .description = { .ptr = "Ambient temperature sensor",
                     .len = 26,
                     .src_type = STR_SRC_STATIC },
    .value_type = SENSOR_VALUE_TYPE_FLOAT,
    .semantics = SENSOR_SEMANTICS_TEMPERATURE,
    .has_unit = true,
    .unit = { .ptr = "C", .len = 1, .src_type = STR_SRC_STATIC },
    .read_func = NULL,
    .wake_interval_sec = 60,
  };
  sensor_t s2 = {
    .id = 2,
    .name = { .ptr = "Humidity", .len = 8, .src_type = STR_SRC_STATIC },
    .description = { .ptr = "Relative humidity sensor",
                     .len = 24,
                     .src_type = STR_SRC_STATIC },
    .value_type = SENSOR_VALUE_TYPE_FLOAT,
    .semantics = SENSOR_SEMANTICS_HUMIDITY,
    .has_unit = true,
    .unit = { .ptr = "%", .len = 1, .src_type = STR_SRC_STATIC },
    .read_func = NULL,
    .wake_interval_sec = 120,
  };
  sensor_t s3 = {
    .id = 3,
    .name = { .ptr = "CO2", .len = 3, .src_type = STR_SRC_STATIC },
    .description = { .ptr = "Carbon dioxide concentration",
                     .len = 28,
                     .src_type = STR_SRC_STATIC },
    .value_type = SENSOR_VALUE_TYPE_FLOAT,
    .semantics = SENSOR_SEMANTICS_CO2,
    .has_unit = false,
    .unit = LORIS_STR_NONE,
    .read_func = NULL,
    .wake_interval_sec = 300,
  };

  function_t f1 = {
    .id = 10,
    .name = { .ptr = "Reboot", .len = 6, .src_type = STR_SRC_STATIC },
    .description = { .ptr = "Reboots the device",
                     .len = 18,
                     .src_type = STR_SRC_STATIC },
    .arg_type = FUNC_ARG_TYPE_VOID,
    .call_function = NULL,
    .wake_interval_sec = 0,
  };
  function_t f2 = {
    .id = 11,
    .name = { .ptr = "SetInterval", .len = 11, .src_type = STR_SRC_STATIC },
    .description = { .ptr = "Sets sensor update interval in seconds",
                     .len = 39,
                     .src_type = STR_SRC_STATIC },
    .arg_type = FUNC_ARG_TYPE_INT,
    .call_function = NULL,
    .wake_interval_sec = 10,
  };

  uplink_t ul =
      {.payload_type = UPLINK_PAYLOAD_TYPE_CAPABILITIES,
       .payload.capabilities = {
           .device_name =
               {
                   .ptr = "WeatherStation_01",
                   .len = 17,
                   .src_type = STR_SRC_STATIC,
               },
           .device_class = DEVICE_CLASS_A,
       }};

  sys_slist_init(&ul.payload.capabilities.sensors);
  sys_slist_append(&ul.payload.capabilities.sensors, &s1.node);
  sys_slist_append(&ul.payload.capabilities.sensors, &s2.node);
  sys_slist_append(&ul.payload.capabilities.sensors, &s3.node);

  sys_slist_init(&ul.payload.capabilities.functions);
  sys_slist_append(&ul.payload.capabilities.functions, &f1.node);
  sys_slist_append(&ul.payload.capabilities.functions, &f2.node);

  char buf[1024];
  size_t bytes_written = 0;
  zassert_equal(encode_uplink(buf, sizeof(buf), &ul, &bytes_written), OK);
  zassert_true(bytes_written > 0);

  uplink_t decoded = { 0 };
  zassert_equal(decode_uplink(&decoded, buf, bytes_written), OK);
  assert_uplinks_equal(&ul, &decoded);
  uplink_free(&decoded);
}

ZTEST(codec_uplink, test_above_cap) {
  uplink_t ul = {
    .payload_type = UPLINK_PAYLOAD_TYPE_REPORT,
    .payload.report.sensor_id = 4,
    .payload.report.which_value = REPORT_VALUE_INT,
    .payload.report.value.int_val = 10,
  };

  char buf[2]; // too small, should fail
  size_t bytes_written = 0;
  zassert_equal(encode_uplink(buf, sizeof(buf), &ul, &bytes_written), ERROR);
}
```

## src/test_lorawan.c
```c
#include <errno.h>
#include <string.h>
#include <zephyr/fff.h>
#include <zephyr/ztest.h>

#include "loris/lorawan.h"

FAKE_VALUE_FUNC(int, lorawan_set_region, enum lorawan_region);
FAKE_VALUE_FUNC(int, lorawan_start);
FAKE_VALUE_FUNC(int, lorawan_join, const struct lorawan_join_config*);
FAKE_VALUE_FUNC(
    int,
    lorawan_send,
    uint8_t,
    uint8_t*,
    uint8_t,
    enum lorawan_message_type
);
FAKE_VALUE_FUNC(int, lorawan_request_link_check, bool);
FAKE_VOID_FUNC(lorawan_register_downlink_callback, struct lorawan_downlink_cb*);

typedef uint8_t (*battery_cb_t)(void);
typedef void (*dr_changed_cb_t)(enum lorawan_datarate);
typedef void (*link_check_ans_cb_t)(uint8_t, uint8_t);

FAKE_VOID_FUNC(lorawan_register_battery_level_callback, battery_cb_t);
FAKE_VOID_FUNC(lorawan_register_dr_changed_callback, dr_changed_cb_t);
FAKE_VOID_FUNC(lorawan_register_link_check_ans_callback, link_check_ans_cb_t);
FAKE_VOID_FUNC(lorawan_enable_adr, bool);
FAKE_VALUE_FUNC(int, lorawan_set_datarate, enum lorawan_datarate);

static struct lorawan_join_config captured_join_cfg;

static int custom_fake_lorawan_join(const struct lorawan_join_config* cfg) {
  if (cfg != NULL) {
    captured_join_cfg = *cfg;
  }
  return lorawan_join_fake.return_val;
}

static void before_test(void* fixture) {
  RESET_FAKE(lorawan_set_region);
  RESET_FAKE(lorawan_start);
  RESET_FAKE(lorawan_join);
  RESET_FAKE(lorawan_send);
  RESET_FAKE(lorawan_request_link_check);
  RESET_FAKE(lorawan_register_downlink_callback);
  RESET_FAKE(lorawan_register_battery_level_callback);
  RESET_FAKE(lorawan_register_dr_changed_callback);
  RESET_FAKE(lorawan_register_link_check_ans_callback);
  RESET_FAKE(lorawan_enable_adr);
  RESET_FAKE(lorawan_set_datarate);

  FFF_RESET_HISTORY();

  memset(&captured_join_cfg, 0, sizeof(captured_join_cfg));

  lorawan_set_region_fake.return_val = 0;
  lorawan_start_fake.return_val = 0;
  lorawan_join_fake.return_val = 0;
  lorawan_join_fake.custom_fake = custom_fake_lorawan_join;
  lorawan_request_link_check_fake.return_val = 0;
}

ZTEST_SUITE(lorawan_suite, NULL, NULL, before_test, NULL, NULL);

ZTEST(lorawan_suite, test_otaa_join_increments_devnonce) {
  uint8_t dev_eui[8] = { 0x01 };
  uint8_t join_eui[8] = { 0x02 };
  uint8_t app_key[16] = { 0x03 };
  uint8_t nwk_key[16] = { 0x04 };

  lr_lw_join_otaa_config_t cfg = {
    .dev_eui = dev_eui,
    .join_eui = join_eui,
    .app_key = app_key,
    .nwk_key = nwk_key,
  };

  zassert_equal(lr_lw_join_otaa(&cfg, LORAWAN_REGION_EU868), LR_LW_OK);
  uint16_t first_nonce = captured_join_cfg.otaa.dev_nonce;

  zassert_equal(lr_lw_join_otaa(&cfg, LORAWAN_REGION_EU868), LR_LW_OK);
  uint16_t second_nonce = captured_join_cfg.otaa.dev_nonce;

  zassert_equal(second_nonce, (uint16_t)(first_nonce + 1));
}

typedef struct join_failure_case {
  int set_region_ret;
  int start_ret;
  int join_ret;
  lr_lw_result_t expected_res;
} join_failure_case_t;

// clang-format off
static const join_failure_case_t join_failure_cases[] = {
    {.set_region_ret = -1, .start_ret = 0, .join_ret = 0, .expected_res = LR_LW_ERR_SET_REGION_FAILED},
    {.set_region_ret = 0, .start_ret = -1, .join_ret = 0, .expected_res = LR_LW_ERR_START_FAILED},
    {.set_region_ret = 0, .start_ret = 0, .join_ret = -1, .expected_res = LR_LW_ERR_JOIN_FAILED},
};
// clang-format on

ZTEST_DEFINE_PARAM_VALUES_ARRAY(join_failure_configs, join_failure_cases);
ZTEST_INSTANTIATE_TEST_SUITE_P(
    join_failures,
    lorawan_suite,
    test_join_failures,
    join_failure_configs
);

ZTEST_P(lorawan_suite, test_join_failures) {
  join_failure_case_t tc = ZTEST_GET_PARAM(join_failure_case_t);

  lorawan_set_region_fake.return_val = tc.set_region_ret;
  lorawan_start_fake.return_val = tc.start_ret;
  lorawan_join_fake.return_val = tc.join_ret;

  uint8_t dev_eui[8] = { 0 };
  uint8_t join_eui[8] = { 0 };
  uint8_t app_key[16] = { 0 };
  uint8_t nwk_key[16] = { 0 };

  lr_lw_join_otaa_config_t cfg = {
    .dev_eui = dev_eui,
    .join_eui = join_eui,
    .app_key = app_key,
    .nwk_key = nwk_key,
  };

  lr_lw_result_t res = lr_lw_join_otaa(&cfg, (enum lorawan_region)0);
  zassert_equal(res, tc.expected_res, "res = %i", res);
}

ZTEST(lorawan_suite, test_abp_join_success) {
  uint8_t dev_eui[8] = { 0x01 };
  uint8_t app_skey[16] = { 0x02 };
  uint8_t nwk_skey[16] = { 0x03 };
  uint8_t app_eui[8] = { 0x04 };

  lr_lw_join_abp_config_t cfg = {
    .dev_eui = dev_eui,
    .dev_addr = 0x12345678,
    .app_skey = app_skey,
    .nwk_skey = nwk_skey,
    .app_eui = app_eui,
  };

  zassert_equal(lr_lw_join_abp(&cfg, (enum lorawan_region)0), LR_LW_OK);
  zassert_equal(lorawan_join_fake.call_count, 1);
  zassert_equal(captured_join_cfg.mode, LORAWAN_ACT_ABP);
  zassert_equal(captured_join_cfg.dev_eui, dev_eui);
  zassert_equal(captured_join_cfg.abp.dev_addr, cfg.dev_addr);
  zassert_equal(captured_join_cfg.abp.app_skey, app_skey);
  zassert_equal(captured_join_cfg.abp.nwk_skey, nwk_skey);
  zassert_equal(captured_join_cfg.abp.app_eui, app_eui);
}

typedef struct send_test_case {
  int lorawan_ret;
  lr_lw_result_t expected_res;
} send_test_case_t;

// clang-format off
static const send_test_case_t send_cases[] = {
    {.lorawan_ret = 0, .expected_res = LR_LW_OK},
    {.lorawan_ret = -EAGAIN, .expected_res = LR_LW_ERR_DUTY_CYCLE_EXCEEDED},
    {.lorawan_ret = -ECONNREFUSED, .expected_res = LR_LW_ERR_DUTY_CYCLE_EXCEEDED },
    {.lorawan_ret = -EIO, .expected_res = LR_LW_ERR_SEND_FAILED},
};
// clang-format on

ZTEST_DEFINE_PARAM_VALUES_ARRAY(send_configs, send_cases);
ZTEST_INSTANTIATE_TEST_SUITE_P(
    send_suite,
    lorawan_suite,
    test_lr_lw_send_status,
    send_configs
);

ZTEST_P(lorawan_suite, test_lr_lw_send_status) {
  send_test_case_t tc = ZTEST_GET_PARAM(send_test_case_t);
  lorawan_send_fake.return_val = tc.lorawan_ret;

  uint8_t payload[] = { 0xDE, 0xAD, 0xBE, 0xEF };
  zassert_equal(
      lr_lw_send(10, payload, sizeof(payload), LORAWAN_MSG_UNCONFIRMED),
      tc.expected_res
  );
  zassert_equal(lorawan_send_fake.arg0_val, 10);
  zassert_equal(lorawan_send_fake.arg1_val, payload);
  zassert_equal(lorawan_send_fake.arg2_val, sizeof(payload));
  zassert_equal(lorawan_send_fake.arg3_val, LORAWAN_MSG_UNCONFIRMED);
}

typedef struct dr_test_case {
  int lorawan_ret;
  lr_lw_result_t expected_res;
} dr_test_case_t;

// clang-format off
static const dr_test_case_t dr_cases[] = {
    {.lorawan_ret = 0, .expected_res = LR_LW_OK},
    {.lorawan_ret = -EINVAL, .expected_res = LR_LW_INVALID_DATARATE_OR_ADR_ENABLED},
    {.lorawan_ret = -50, .expected_res = LR_LW_ERR_UNKNOWN},
};
// clang-format on

ZTEST_DEFINE_PARAM_VALUES_ARRAY(dr_configs, dr_cases);
ZTEST_INSTANTIATE_TEST_SUITE_P(
    dr_suite,
    lorawan_suite,
    test_lr_lw_set_datarate_status,
    dr_configs
);

ZTEST_P(lorawan_suite, test_lr_lw_set_datarate_status) {
  dr_test_case_t tc = ZTEST_GET_PARAM(dr_test_case_t);
  lorawan_set_datarate_fake.return_val = tc.lorawan_ret;

  zassert_equal(lr_lw_set_datarate((enum lorawan_datarate)2), tc.expected_res);
  zassert_equal(lorawan_set_datarate_fake.arg0_val, (enum lorawan_datarate)2);
}

ZTEST(lorawan_suite, test_request_link_check) {
  lr_lw_request_link_check(true);
  zassert_equal(lorawan_request_link_check_fake.call_count, 1);
  zassert_equal(lorawan_request_link_check_fake.arg0_val, true);

  lr_lw_request_link_check(false);
  zassert_equal(lorawan_request_link_check_fake.call_count, 2);
  zassert_equal(lorawan_request_link_check_fake.arg0_val, false);
}

static void mock_downlink_cb(
    uint8_t port,
    uint8_t flags,
    int16_t rssi,
    int8_t snr,
    uint8_t len,
    const uint8_t* data
) {}
static uint8_t mock_battery_cb(void) { return 254; }
static void mock_dr_changed_cb(enum lorawan_datarate dr) {}
static void mock_link_check_ans_cb(uint8_t demod_margin, uint8_t nb_gateways) {}

ZTEST(lorawan_suite, test_register_downlink_callback) {
  struct lorawan_downlink_cb dummy = { 0 };
  lr_lw_register_downlink_callback(&dummy, mock_downlink_cb);

  zassert_equal(lorawan_register_downlink_callback_fake.call_count, 1);
  zassert_equal(dummy.port, LW_RECV_PORT_ANY);
  zassert_equal(dummy.cb, mock_downlink_cb);
}

ZTEST(lorawan_suite, test_register_other_callbacks) {
  lr_lw_register_battery_lvl_callback(mock_battery_cb);
  zassert_equal(lorawan_register_battery_level_callback_fake.call_count, 1);
  zassert_equal(
      lorawan_register_battery_level_callback_fake.arg0_val,
      mock_battery_cb
  );

  lr_lw_register_dr_changed_callback(mock_dr_changed_cb);
  zassert_equal(lorawan_register_dr_changed_callback_fake.call_count, 1);
  zassert_equal(
      lorawan_register_dr_changed_callback_fake.arg0_val,
      mock_dr_changed_cb
  );

  lr_lw_register_link_check_ans_callback(mock_link_check_ans_cb);
  zassert_equal(lorawan_register_link_check_ans_callback_fake.call_count, 1);
  zassert_equal(
      lorawan_register_link_check_ans_callback_fake.arg0_val,
      mock_link_check_ans_cb
  );
}

ZTEST(lorawan_suite, test_set_adr) {
  lr_lw_set_adr_mode(true);
  zassert_equal(lorawan_enable_adr_fake.call_count, 1);
  zassert_equal(lorawan_enable_adr_fake.arg0_val, true);

  lr_lw_set_adr_mode(false);
  zassert_equal(lorawan_enable_adr_fake.call_count, 2);
  zassert_equal(lorawan_enable_adr_fake.arg0_val, false);
}
```

## src/test_main.c
```c
#include <assert.h>
#include <zephyr/ztest.h>

#include "loris/models/capabilities.h"
#include "loris/models/report.h"
#include "loris/models/sensor.h"
#include "zephyr/sys/min_heap.h"
#include "zephyr/ztest_assert.h"
#include "zephyr/ztest_test.h"

ZTEST_SUITE(runtime, NULL, NULL, NULL, NULL, NULL);

capabilities_t caps;

report_t report_func(struct sensor* t);
result_t do_sth_int(void* arg);
result_t do_sth_float(void* arg);

/*
ZTEST(capabilities, test_sensor_runtime_submodule) {
  capabilities_init(&caps, "capabilities_sensors", DEVICE_CLASS_A);

  zassert_equal(
      capabilities_add_sensor(&caps, "test_name 1", "Measures temperature",
                              VALUE_TYPE_TEMPERATURE, "C", &report_func, 6),
      OK);
  zassert_equal(
      capabilities_add_sensor(&caps, "test_name 2", "Measures temperature",
                              VALUE_TYPE_TEMPERATURE, "F", &report_func, 3),
      OK);

  run_sensors(&caps);
}
*/
```

## src/test_nvs.c
```c
#include <stdbool.h>
#include <stdint.h>
#include <string.h>
#include <zephyr/ztest.h>

#include "loris/nvs.h"

static void lr_nvs_test_before(void* fixture) {
  lr_nvs_init();
  lr_nvs_clear();
  lr_nvs_init();
}

ZTEST_SUITE(lr_nvs, NULL, NULL, lr_nvs_test_before, NULL, NULL);

ZTEST(lr_nvs, test_init_idempotent) {
  zassert_equal(lr_nvs_init(), LR_NVS_OK);
  zassert_equal(lr_nvs_init(), LR_NVS_OK);
}

typedef struct nvs_type_param {
  lr_nvs_id_t id;
  const void* data;
  size_t len;
} nvs_type_param_t;

static const uint32_t val_u32 = 0xDEADBEEF;
static const char val_char = 'Z';
static const bool val_bool = true;
static const char val_str[] = "Zephyr NVS test string";
static const int32_t val_i32 = -123456;

// clang-format off
static const nvs_type_param_t type_params[] = {
    {.id = LR_NVS_ID_LW_LAST_USED_DEVNONCE, .data = &val_u32, .len = sizeof(val_u32)},
    {.id = LR_NVS_ID_LW_LAST_USED_DEVNONCE, .data = &val_char, .len = sizeof(val_char)},
    {.id = LR_NVS_ID_LW_LAST_USED_DEVNONCE, .data = &val_bool, .len = sizeof(val_bool)},
    {.id = LR_NVS_ID_LW_LAST_USED_DEVNONCE, .data = val_str, .len = sizeof(val_str)},
    {.id = LR_NVS_ID_LW_LAST_USED_DEVNONCE, .data = &val_i32, .len = sizeof(val_i32)},
};
// clang-format on

ZTEST_DEFINE_PARAM_VALUES_ARRAY(nvs_type_params, type_params);
ZTEST_INSTANTIATE_TEST_SUITE_P(
    type_roundtrips,
    lr_nvs,
    test_write_read_roundtrip_types,
    nvs_type_params
);

ZTEST_P(lr_nvs, test_write_read_roundtrip_types) {
  nvs_type_param_t param = ZTEST_GET_PARAM(nvs_type_param_t);
  uint8_t read_buf[64] = { 0 };
  size_t bytes_written = 0;
  size_t bytes_read = 0;

  zassert_equal(
      lr_nvs_write(param.id, (void*)param.data, param.len, &bytes_written),
      LR_NVS_OK
  );
  zassert_equal(bytes_written, param.len);

  zassert_equal(
      lr_nvs_read(param.id, read_buf, sizeof(read_buf), &bytes_read),
      LR_NVS_OK
  );
  zassert_equal(bytes_read, param.len);
  zassert_mem_equal(read_buf, param.data, param.len);
}

ZTEST(lr_nvs, test_read_unwritten_id) {
  uint32_t buf = 0;
  size_t bytes_read = 0;

  lr_nvs_result_t res = lr_nvs_read(
      LR_NVS_ID_LW_LAST_USED_DEVNONCE,
      &buf,
      sizeof(buf),
      &bytes_read
  );
  zassert_equal(res, LR_NVS_ERR_NO_VALUE, "res = %d", res);
}

ZTEST(lr_nvs, test_id_sentinels_and_out_of_bounds) {
  uint32_t val = 42;
  size_t bytes_written = 0;
  size_t bytes_read = 0;

  zassert_equal(
      lr_nvs_write(LR_NVS_ID_MIN_SENTINEL, &val, sizeof(val), &bytes_written),
      LR_NVS_ERR_INV_ID
  );
  zassert_equal(
      lr_nvs_read(LR_NVS_ID_MIN_SENTINEL, &val, sizeof(val), &bytes_read),
      LR_NVS_ERR_INV_ID
  );

  zassert_equal(
      lr_nvs_write(LR_NVS_ID_MAX_SENTINEL, &val, sizeof(val), &bytes_written),
      LR_NVS_ERR_INV_ID
  );
  zassert_equal(
      lr_nvs_read(LR_NVS_ID_MAX_SENTINEL, &val, sizeof(val), &bytes_read),
      LR_NVS_ERR_INV_ID
  );

  lr_nvs_id_t underflow_id = (lr_nvs_id_t)(LR_NVS_ID_MIN_SENTINEL - 1);
  zassert_equal(
      lr_nvs_write(underflow_id, &val, sizeof(val), &bytes_written),
      LR_NVS_ERR_INV_ID
  );
  zassert_equal(
      lr_nvs_read(underflow_id, &val, sizeof(val), &bytes_read),
      LR_NVS_ERR_INV_ID
  );

  lr_nvs_id_t overflow_id = (lr_nvs_id_t)(LR_NVS_ID_MAX_SENTINEL + 1);
  zassert_equal(
      lr_nvs_write(overflow_id, &val, sizeof(val), &bytes_written),
      LR_NVS_ERR_INV_ID
  );
  zassert_equal(
      lr_nvs_read(overflow_id, &val, sizeof(val), &bytes_read),
      LR_NVS_ERR_INV_ID
  );
}

ZTEST(lr_nvs, test_null_bytes_pointers) {
  uint32_t write_val = 0xABCD1234;
  uint32_t read_val = 0;

  zassert_equal(
      lr_nvs_write(
          LR_NVS_ID_LW_LAST_USED_DEVNONCE,
          &write_val,
          sizeof(write_val),
          NULL
      ),
      LR_NVS_OK
  );
  zassert_equal(
      lr_nvs_read(
          LR_NVS_ID_LW_LAST_USED_DEVNONCE,
          &read_val,
          sizeof(read_val),
          NULL
      ),
      LR_NVS_OK
  );
  zassert_equal(read_val, write_val);
}

ZTEST(lr_nvs, test_null_data_buffer) {
  uint32_t val = 123;
  size_t bytes_written = 0;
  size_t bytes_read = 0;

  zassert_equal(
      lr_nvs_write(
          LR_NVS_ID_LW_LAST_USED_DEVNONCE,
          NULL,
          sizeof(val),
          &bytes_written
      ),
      LR_NVS_ERR_INVALID_ARG
  );
  zassert_equal(
      lr_nvs_read(
          LR_NVS_ID_LW_LAST_USED_DEVNONCE,
          NULL,
          sizeof(val),
          &bytes_read
      ),
      LR_NVS_ERR_INVALID_ARG
  );
}

ZTEST(lr_nvs, test_partial_read_truncation) {
  uint32_t write_val = 0x12345678;
  uint16_t read_val = 0;
  size_t bytes_read = 0;

  zassert_equal(
      lr_nvs_write(
          LR_NVS_ID_LW_LAST_USED_DEVNONCE,
          &write_val,
          sizeof(write_val),
          NULL
      ),
      LR_NVS_OK
  );
  zassert_equal(
      lr_nvs_read(
          LR_NVS_ID_LW_LAST_USED_DEVNONCE,
          &read_val,
          sizeof(read_val),
          &bytes_read
      ),
      LR_NVS_OK
  );
  zassert_equal(bytes_read, sizeof(read_val));
  zassert_mem_equal(&read_val, &write_val, sizeof(read_val));
}
```

## src/test_runtime.c
```c
#include <assert.h>
#include <zephyr/ztest.h>

#include "loris/models/capabilities.h"
#include "loris/models/report.h"
#include "loris/models/sensor.h"
#include "loris/runtime.h"
#include "zephyr/sys/min_heap.h"
#include "zephyr/ztest_assert.h"
#include "zephyr/ztest_test.h"

ZTEST_SUITE(runtime, NULL, NULL, NULL, NULL, NULL);

capabilities_t caps;

report_t report_func(struct sensor* t);
result_t do_sth_int(void* arg);
result_t do_sth_float(void* arg);

ZTEST(capabilities, test_sensor_runtime_submodule) {
  capabilities_init(&caps, "capabilities_sensors", DEVICE_CLASS_A);

  zassert_equal(
      capabilities_add_sensor(&caps, "test_name 1", "Measures temperature",
                              VALUE_TYPE_TEMPERATURE, "C", &report_func, 6),
      OK);
  zassert_equal(
      capabilities_add_sensor(&caps, "test_name 2", "Measures temperature",
                              VALUE_TYPE_TEMPERATURE, "F", &report_func, 3),
      OK);

  run_sensors(&caps);
}
```

## src/test_str.c
```c
#include <stdlib.h>
#include <string.h>
#include <zephyr/ztest.h>

#include "loris/str.h"

static str_t a;
static str_t b;
static str_t pool[STR_SLAB_BLOCKS];
static char long_str[STR_SLAB_BLOCK_SIZE + 10];
static size_t free_at_start;

static void str_before(void* fixture) {
  ARG_UNUSED(fixture);
  a = LORIS_STR_NONE;
  b = LORIS_STR_NONE;
  for (int i = 0; i < STR_SLAB_BLOCKS; i++) {
    pool[i] = LORIS_STR_NONE;
  }
  memset(long_str, 'a', sizeof(long_str) - 1);
  long_str[sizeof(long_str) - 1] = '\0';
  free_at_start = str_slab_num_free();
}

static void str_after(void* fixture) {
  ARG_UNUSED(fixture);
  str_free(&a);
  str_free(&b);
  for (int i = 0; i < STR_SLAB_BLOCKS; i++) {
    str_free(&pool[i]);
  }
  zassert_equal(str_slab_num_free(), free_at_start, "slab blocks leaked");
}

ZTEST_SUITE(str, NULL, NULL, str_before, str_after, NULL);

static void expect_none(const str_t* s) {
  zassert_is_null(s->ptr);
  zassert_equal(s->len, 0);
  zassert_equal(s->src_type, STR_SRC_NONE);
}

static void expect_str(
    const str_t* s,
    const char* content,
    size_t len,
    str_src_type_t type
) {
  zassert_not_null(s->ptr);
  zassert_equal(s->len, len);
  zassert_equal(s->src_type, type);
  zassert_equal(strlen(s->ptr), len);
  if (content != NULL) {
    zassert_str_equal(s->ptr, content);
  }
}

ZTEST(str, test_none) {
  expect_none(&a);
  str_free(NULL);
  str_free(&a);
  expect_none(&a);
}

ZTEST(str, test_invalid_args) {
  zassert_equal(str_from_static(&a, NULL), ERROR);
  zassert_equal(str_from_static(NULL, "x"), ERROR);
  zassert_equal(str_borrow_cstr(&a, NULL), ERROR);
  zassert_equal(str_borrow_cstr(NULL, "x"), ERROR);
  zassert_equal(str_borrow(&a, NULL), ERROR);
  zassert_equal(str_borrow(NULL, &b), ERROR);
  zassert_equal(str_alloc_dynamic(&a, NULL), ERROR);
  zassert_equal(str_alloc_dynamic(NULL, "x"), ERROR);
  zassert_equal(str_alloc_slab(&a, NULL), ERROR);
  zassert_equal(str_alloc_slab(NULL, "x"), ERROR);
  zassert_equal(str_alloc_slab(&a, long_str), ERROR);
  zassert_equal(str_alloc_smart(&a, NULL), ERROR);
  zassert_equal(str_alloc_smart(NULL, "x"), ERROR);
  zassert_equal(str_alloc_smart_len(NULL, 5), ERROR);
  zassert_equal(str_move(NULL, &b), ERROR);
  zassert_equal(str_move(&a, NULL), ERROR);
  zassert_equal(str_move(NULL, NULL), ERROR);
  expect_none(&a);
}

ZTEST(str, test_static_and_borrowed) {
  const char* cstr = "hello";

  zassert_equal(str_from_static(&a, cstr), OK);
  expect_str(&a, cstr, 5, STR_SRC_STATIC);
  zassert_equal(a.ptr, cstr);

  zassert_equal(str_borrow_cstr(&b, cstr), OK);
  expect_str(&b, cstr, 5, STR_SRC_BORROWED);
  zassert_equal(b.ptr, cstr);

  zassert_equal(str_alloc_dynamic(&a, "dyn"), OK);
  zassert_equal(str_borrow(&b, &a), OK);
  expect_str(&b, "dyn", 3, STR_SRC_BORROWED);
  zassert_equal(b.ptr, a.ptr);

  str_free(&b);
  expect_none(&b);
  expect_str(&a, "dyn", 3, STR_SRC_DYNAMIC);
}

ZTEST(str, test_alloc_copies) {
  static const struct {
    result_t (*fn)(str_t*, const char*);
    str_src_type_t type;
  } cases[] = {
    { str_alloc_dynamic, STR_SRC_DYNAMIC },
    { str_alloc_slab, STR_SRC_SLAB },
    { str_alloc_smart, STR_SRC_SLAB },
  };
  char src[] = "hello";

  for (size_t i = 0; i < ARRAY_SIZE(cases); i++) {
    zassert_equal(cases[i].fn(&a, src), OK, "case %zu", i);
    expect_str(&a, "hello", 5, cases[i].type);
    zassert_not_equal(a.ptr, src);
    str_free(&a);
    expect_none(&a);
  }

  zassert_equal(str_alloc_smart(&a, long_str), OK);
  expect_str(&a, long_str, strlen(long_str), STR_SRC_DYNAMIC);
}

ZTEST(str, test_alloc_smart_len_sizes) {
  static const struct {
    size_t len;
    str_src_type_t type;
  } cases[] = {
    { 0, STR_SRC_SLAB },
    { STR_SLAB_BLOCK_SIZE - 1, STR_SRC_SLAB },
    { STR_SLAB_BLOCK_SIZE, STR_SRC_DYNAMIC },
    { STR_SLAB_BLOCK_SIZE * 4, STR_SRC_DYNAMIC },
  };

  for (size_t i = 0; i < ARRAY_SIZE(cases); i++) {
    zassert_equal(str_alloc_smart_len(&a, cases[i].len), OK, "case %zu", i);
    zassert_equal(((const char*)a.ptr)[a.len], '\0', "case %zu", i);

    memset((char*)a.ptr, 'x', a.len);
    ((char*)a.ptr)[a.len] = '\0';
    expect_str(&a, NULL, cases[i].len, cases[i].type);

    str_free(&a);
    expect_none(&a);
  }
}

ZTEST(str, test_slab_exhaustion) {
  size_t n = str_slab_num_free();
  zassert_true(n > 0 && n <= STR_SLAB_BLOCKS);

  for (size_t i = 0; i < n; i++) {
    zassert_equal(str_alloc_smart_len(&pool[i], 10), OK);
    zassert_equal(pool[i].src_type, STR_SRC_SLAB, "i=%zu", i);
  }
  zassert_equal(str_slab_num_free(), 0);

  zassert_equal(str_alloc_smart_len(&a, 10), OK);
  zassert_equal(a.src_type, STR_SRC_DYNAMIC);

  str_free(&pool[0]);
  zassert_equal(str_alloc_smart_len(&b, 10), OK);
  zassert_equal(b.src_type, STR_SRC_SLAB);
}

ZTEST(str, test_replace_frees_previous) {
  zassert_equal(str_from_static(&a, "static"), OK);

  for (int i = 0; i < STR_SLAB_BLOCKS * 3; i++) {
    zassert_equal(str_alloc_smart_len(&a, 10), OK);
    zassert_equal(a.src_type, STR_SRC_SLAB);
    zassert_equal(str_slab_num_free(), free_at_start - 1, "leaked at %d", i);
  }
}

ZTEST(str, test_move) {
  zassert_equal(str_alloc_slab(&a, "old"), OK);
  zassert_equal(str_alloc_slab(&b, "new"), OK);
  const char* moved = b.ptr;
  zassert_equal(str_slab_num_free(), free_at_start - 2);

  zassert_equal(str_move(&a, &b), OK);
  expect_str(&a, "new", 3, STR_SRC_SLAB);
  zassert_equal(a.ptr, moved);
  expect_none(&b);
  zassert_equal(str_slab_num_free(), free_at_start - 1);

  zassert_equal(str_move(&a, &b), OK);
  expect_none(&a);
  zassert_equal(str_slab_num_free(), free_at_start);

  zassert_equal(str_alloc_dynamic(&a, "hehe"), OK);
  const char* before_ptr = a.ptr;
  zassert_equal(str_move(&a, &a), OK);
  expect_str(&a, "hehe", 4, STR_SRC_DYNAMIC);
  zassert_equal(a.ptr, before_ptr);
}
```
