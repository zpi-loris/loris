## stacja_mierzaca/src/esp32-idf/main/Kconfig.projbuild
```kconfig
menu "Application Configuration"

	choice POLARITY
		prompt "Communication Polarity"
		default TRANSMITTER
		help
			Select Communication Polarity.
		config TRANSMITTER
			bool "Transmitter"
			help
				As Transmitter.
		config RECEIVER
			bool "Receiver"
			help
				As Receiver.
	endchoice

endmenu 
```

## zephyr/modules/libloris/Kconfig
```kconfig
# TODO: find out how to specify LORAWAN_SYSTEM_MAX_RX_ERROR=100
# when LORIS=y

menuconfig LORIS
  bool "Enable loris module"
  depends on (LORA && LORAWAN && ZMS && FLASH && FLASH_MAP && MIN_HEAP) || ZTEST
  help
    Enables the loris module.

    NOTE: to ensure proper LoRaWAN stack functionality set
    LORAWAN_SYSTEM_MAX_RX_ERROR to a reasonable value, e.g. 100.

if LORIS

config LORIS_SENSORS_AMOUNT
  int "How many sensors are in the device"
  default 5

config LORIS_FUNCS_AMOUNT
  int "How many functions are provided"
  default 12

config LORIS_TEST
  bool "Compile additional test helper functions"
  help
    When 'y' compiles additional helper functions not needed in production,
    e.g. uplink DECODING and downlink ENCODING.

config LORIS_RECONNECT_INTERVAL
  int "Defines how often will the device try establish a connection with the server. Unit: Seconds" 
  default 60

config LORIS_UPLINK_QUEUE_SIZE
  int "How many uplink messages can be stored in a queue at once"
  default 10

config LORIS_DOWNLINK_QUEUE_SIZE
  int "How many downlink messages can be stored in a queue at once"
  default 10

endif
```
